## drivers/soc/oppo/Kconfig
```kconfig
#ifdef VENDOR_EDIT
# Bin.Li@EXP.BSP.bootloader.bootflow, 2017/05/15, Add for config oppo software common soft
config OPPO_ARCH_FILE
    bool "for build directory oppo"
    ---help---
    say Y to buid in

config OPPO_COMMON_SOFT
        bool "config oppo common software"
        select OPPO_ARCH_FILE
        help
        define this config to get project verion from sharemem.
        Maybe this value is from CDT or dynamic identify by hardware
        id.

config OPPO_DEVICE_IFNO
        bool "config oppo devinfo"
        select OPPO_ARCH_FILE
        help
        define this config to compile devinfo.c for device register.

#ifdef VENDOR_EDIT
#/* Yu.Kun@CN.NFC.Basic.Hardware, 2020/03/24, Add for oppo nfc chipset */
config OPPO_NFC
  bool "config oppo nfc chipset"
    select OPPO_ARCH_FILE
    help
        define this config to get nfc chipset version from dts.
#endif /* VENDOR_EDIT */

source "drivers/soc/oppo/oppo_project/Kconfig"
source "drivers/soc/oppo/oppo_devinfo/Kconfig"
source "drivers/soc/oppo/oppo_als_cali_value/Kconfig"

#//wenbin.liu@PSW.Kernel.MM, 2018/05/23, Add for Healthinfo monitor
source "drivers/soc/oppo/oppo_healthinfo/Kconfig"
#//Wen.Luo@BSP
#Liang.Zhang@TECH.Storage.Stability.OPPO_SHUTDOWN_DETECT, 2019/04/28, Add for shutdown detect
source "drivers/soc/oppo/oppo_shutdown_detect/Kconfig"
#endif /* VENDOR_EDIT */
source "drivers/soc/oppo/oppo_hypnus/Kconfig"

#Kun.Hu@TECH.BSP.Stability.PHOENIX_PROJECT 2019/06/15, Add for PHOENIX_PROJECT
source "drivers/soc/oppo/oppo_phoenix/Kconfig"

source "drivers/soc/oppo/oppo_power_helper/Kconfig"

#ifdef VENDOR_EDIT
#/* Yu.Kun@CN.NFC.Basic.Hardware, 2020/03/24, Add for oppo nfc chipset */
source "drivers/soc/oppo/oppo_nfc/Kconfig"
#endif /* VENDOR_EDIT */
#endif

#ifdef OPLUS_FEATURE_LOWMEM_DBG
#Hailong.Liu@BSP.Kernel.MM, 2020/06/19, Add for dump memory usage when lowmmem occurs.
source "drivers/soc/oppo/lowmem_dbg/Kconfig"
##endif /* OPLUS_FEATURE_LOWMEM_DBG */

#ifdef VENDOR_EDIT
#Hailong.Liu@BSP.MM 2019/03/18, Add for svelte
source "drivers/soc/oppo/oppo_svelte/Kconfig"
#endif /* VENDOR_EDIT */
```

## drivers/soc/oppo/oppo_power_helper/Kconfig
```kconfig
config POWER_HELPER_SUPPORT
        bool 'power helper support'
        default n
        help
          This option enables support power helper functions.
          If sure, say `Y'.
```

## kernel/power/oppo/Kconfig
```kconfig
config OPPO_POWER_UTIL
	bool "oppo util debug feature"
	depends on PM_SLEEP
	default y
	help
	    Oppo power debug feature
```
